## config/boards/shields/redridingelmo/Kconfig.defconfig
```kconfig
if SHIELD_REDRIDINGELMO

config ZMK_KEYBOARD_NAME
    default "redridingelmo"

endif

CONFIG_ZMK_KSCAN_DEBOUNCE_PRESS_MS=15
CONFIG_ZMK_KSCAN_DEBOUNCE_RELEASE_MS=15

CONFIG_BT_CTLR_TX_PWR_MINUS_8=y  # reduce TX power for battery
CONFIG_BT_PERIPHERAL_PREF_MIN_INT=24
CONFIG_BT_PERIPHERAL_PREF_MAX_INT=56
CONFIG_BT_PERIPHERAL_PREF_SLAVE_LATENCY=30
CONFIG_BT_PERIPHERAL_PREF_TIMEOUT=500
CONFIG_BT_CTLR_CONN_EVT_LEN_EXT=y

CONFIG_ZMK_STUDIO=y
```
